## Kconfig
```kconfig
# ------------------------------------------------------------------------------
# @brief Kconfig flie
# SPDX-FileCopyrightText: 2025 CompanyNameMagicTag
# SPDX-License-Identifier: Apache-2.0
# ------------------------------------------------------------------------------

# @attention 目前 XFusion 所有配置暂定只写在此文件中，
#            如有必要，后续再拆分到各个组件的 Kconfig 文件中。

menu "XFusion"

    # Define CONFIG_XF_CONF_SKIP so we can use XFusion
    # without xf_conf.h file, the xf_conf_internal.h and
    # xf_conf_kconfig.h files are used instead.
    config XF_CONF_SKIP
        bool "Check this to not use custom xf_conf.h"
        default y

    config XF_ENABLE_EXTENDED
        bool "Extended configuration"
        default n

    menu "Extended"

        depends on XF_ENABLE_EXTENDED

        config XF_CONF_EXTENDED_PATH
            string "Extended configuration path"
            default "xf_conf_extended.h"

    endmenu # Extended

    menu "Components"

        menu "common"

            config XF_COMMON_ENABLE_64BITS
                bool "Enable 64 bits"
                default y

            config XF_COMMON_ENABLE_GNU
                bool "Enable GNU"
                default y

            config XF_COMMON_ENABLE_BUILTIN
                bool "Enable GNU Builtin"
                default y

            config XF_ENABLE_ERR_TO_NAME_LOOKUP
                bool "Enable Error Code to Name Lookup"
                default y

        endmenu # common

        menu "dstruct"

            config XF_DEQUE_ENABLE_ZERO_LENGTH_ARRAYS
                bool "Enable DEQUE Zero Length Arrays"
                default n
            
            config XF_DEQUE_ENABLE_BUFFER_POINTER
                bool "Enable DEQUE Buffer Pointer"
                default y

        endmenu # dstruct

        config XF_ENABLE_LOG
            bool "log"
            default y

        menu "log"

            depends on XF_ENABLE_LOG

            config XF_LOG_ENABLE_ERROR
                bool "Enable Error"
                default y
            config XF_LOG_ENABLE_WARN
                bool "Enable Warning"
                default y
            config XF_LOG_ENABLE_INFO
                bool "Enable Information"
                default y
            config XF_LOG_ENABLE_DEBUG
                bool "Enable Debug"
                default y
            config XF_LOG_ENABLE_VERBOSE
                bool "Enable Verbose"
                default y

        endmenu # log

        menu "std"

            choice
                prompt "String functions source"
                default XF_STRING_ENABLE_LIBC
                config XF_STRING_ENABLE_BUILTIN
                    bool "builtin"
                config XF_STRING_ENABLE_LIBC
                    bool "libc"
            endchoice

        endmenu # std

        menu "system"

            menu "check"

                config XF_CHECK_ENABLE_CHECK
                    bool "check"
                    default y

                config XF_CHECK_ENABLE_ASSERT
                    bool "assert"
                    default y

                config XF_CHECK_ENABLE_ERROR_CHECK
                    bool "error check(An error occurs when the return value is not XF_OK.)"
                    default y

            endmenu # check

            menu "ps"

                config XF_PS_MSG_NUM_MAX
                    int "max number of messages"
                    default 16

                config XF_PS_SUBSCRIBER_NUM_MAX
                    int "max number of subscribers"
                    default 16

            endmenu # ps

            menu "stimer"

                config XF_STIMER_NUM_MAX
                    int "max number of timers"
                    default 16

                config XF_STIMER_NO_READY_DELAY
                    int "The delay time when the timer is not ready, in units of tick."
                    default 1000

            endmenu # stimer

            menu "task"

                choice
                    prompt "Local continuation type"
                    default XF_TASK_ENABLE_LC_LABEL
                    config XF_TASK_ENABLE_LC_LABEL
                        bool "label"
                    config XF_TASK_ENABLE_LC_SWITCH
                        bool "switch"
                endchoice

                config XF_TASK_NUM_MAX
                    int "max number of tasks"
                    default 16

                config XF_TASK_NEST_DEPTH_MAX
                    int "max number of task nesting depth"
                    default 6

                config XF_TASK_EVENT_MSG_NUM_MAX
                    int "max number of event messages caches"
                    default 4

            endmenu # task

            menu "tick"

                config XF_TICK_FREQ
                    int "tick frequency, in units of Hz"
                    default 1000

            endmenu # tick

        endmenu # system

    endmenu # Components

    config XF_ENABLE_EXAMPLES
        bool "examples"
        default n

    menu "examples"

        depends on XF_ENABLE_EXAMPLES

    endmenu # examples

endmenu
```

## components/Kconfig
```kconfig
# ------------------------------------------------------------------------------
# @brief Kconfig flie
# SPDX-FileCopyrightText: 2025 CompanyNameMagicTag
# SPDX-License-Identifier: Apache-2.0
# ------------------------------------------------------------------------------

menu "Components"

    config XF_ENABLE_algo
        bool "algo"
        default n
    if XF_ENABLE_algo
        orsource "algo/Kconfig"
    endif

    config XF_ENABLE_common
        bool "common"
        default y
    if XF_ENABLE_common
        orsource "common/Kconfig"
    endif

endmenu
```

## projects/xf_project/components/freertos/Kconfig
```kconfig
menu "FreeRTOS"

    config FREERTOS_HZ
        int "configTICK_RATE_HZ"
        range 1 1000
        default 1000
        help
            Sets the FreeRTOS tick interrupt frequency in Hz (see configTICK_RATE_HZ documentation for more
            details).

    config TOTAL_HEAP_SIZE
        int "configTOTAL_HEAP_SIZE"
        default 16777216 # 16MB
        help
            Sets the total heap size in bytes (see configTOTAL_HEAP_SIZE documentation for more details).

endmenu # FreeRTOS
```
